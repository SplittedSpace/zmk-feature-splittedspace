## Kconfig
```kconfig
config ZMK_LED_WIDGETS
    bool "Display widgets on top of LEDs"

if ZMK_LED_WIDGETS
    config ZMK_LED_WIDGETS_MAX_WIDGET_NUM
        int "Maximum number of widgets for a event type"
        default 5
endif


menu "Splitted Space behaviors"

config ZMK_BEHAVIOR_INDICATORS
    bool "Enable behavior indicators"
    default y

endmenu
```
